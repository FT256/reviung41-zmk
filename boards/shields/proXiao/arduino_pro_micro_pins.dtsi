/*
 * Copyright (c) 2020 Pete Johanson
 *
 * SPDX-License-Identifier: MIT
 */

/ {
    pro_micro: connector {
        compatible = "arduino-pro-micro";
        #gpio-cells = <2>;
        gpio-map-mask = <0xffffffff 0xffffffc0>;
        gpio-map-pass-thru = <0 0x3f>;
        gpio-map
            = <0 0 &gpio0 8 0>      /* D0(NC) */
            , <1 0 &gpio0 6 0>      /* D1(NC) */
            , <2 0 &gpio0 17 0>     /* D2(NC) */
            , <3 0 &xiao_d 8 0>     /* D3 */
            , <4 0 &xiao_d 7 0>     /* D4 */
            , <5 0 &xiao_d 8 0>     /* D5 */
            , <6 0 &xiao_d 9 0>     /* D6 */
            , <7 0 &xiao_d 10 0>    /* D7 */
            , <8 0 &gpio0 10 0>     /* D8 */
            , <9 0 &gpio0 9 0>      /* D9 */
            , <10 0 &xiao_d 7 0>    /* D10 */
            , <16 0 &xiao_d 0 0>    /* D16 */
            , <14 0 &xiao_d 1 0>    /* D14 */
            , <15 0 &xiao_d 2 0>    /* D15 */
            , <18 0 &xiao_d 3 0>    /* D18 */
            , <19 0 &xiao_d 6 0>    /* D19 */
            , <20 0 &xiao_d 5 0>    /* D20 */
            , <21 0 &xiao_d 4 0>    /* D21 */
            ;
    };
};

pro_micro_d: &pro_micro {};
pro_micro_i2c: { status = "disabled"; };
pro_micro_spi: { status = "disabled"; };
pro_micro_serial: { status = "disabled"; };
